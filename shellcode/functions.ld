PROVIDE(fastboot_run = 0xffff0000f886fb88);
PROVIDE(fastboot_run_cmd = 0xffff0000f886fcb4);
PROVIDE(fastboot_stop = 0xffff0000f886fc5c);
PROVIDE(fastboot_activity_cb = 0xffff0000f88144f0);
PROVIDE(memmove = 0xffff0000f8876044);
PROVIDE(paddr_to_kvaddr = 0xffff0000f886b960);

